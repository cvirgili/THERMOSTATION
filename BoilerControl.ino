#include <ESP8266WiFi.h>
#include <SPI.h>
#include <Wire.h>
#include <Adafruit_GFX.h>
#include <Adafruit_SSD1306.h>
#include <RobotoMono.h>

const unsigned char Hand[] PROGMEM = {
    // 'hand', 32x32px
    0x00, 0x00, 0x00, 0x00, 0x00, 0x00, 0x00, 0x00, 0x00, 0x0c, 0x60, 0x00, 0x00, 0x0c, 0x60, 0x00,
    0x00, 0xc6, 0x60, 0x00, 0x00, 0xe6, 0x60, 0x00, 0x00, 0x66, 0x60, 0x00, 0x00, 0x33, 0x61, 0x80,
    0x00, 0x33, 0x31, 0x80, 0x03, 0x1b, 0x33, 0x00, 0x03, 0x9f, 0xf3, 0x00, 0x01, 0xcf, 0xff, 0x00,
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    0x00, 0x00, 0x00, 0x00, 0x00, 0x00, 0x00, 0x00, 0x00, 0x00, 0x00, 0x00, 0x00, 0x00, 0x00, 0x00};

const unsigned char BoilerOn[] PROGMEM = {
    // 'flame', 42x64px
    0x00, 0x00, 0x00, 0x00, 0x00, 0x00, 0x00, 0x00, 0x00, 0x00, 0x00, 0x00, 0x00, 0x00, 0x00, 0x00,
    0x00, 0x00, 0x00, 0x00, 0x00, 0x00, 0x00, 0x00, 0x00, 0x00, 0x00, 0x00, 0x00, 0x00, 0x00, 0x00,
    0x00, 0x00, 0x00, 0x00, 0x00, 0x00, 0x00, 0x00, 0x00, 0x00, 0x00, 0x00, 0x00, 0x00, 0x00, 0x00,
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    0x00, 0x00, 0x00, 0x00, 0x00, 0x00, 0x00, 0x00, 0x00, 0x00, 0x00, 0x00, 0x00, 0x00, 0x00, 0x00};

const unsigned char BoilerOff[] PROGMEM = {
    // 'off', 42x64px
    0x00, 0x00, 0x00, 0x00, 0x00, 0x00, 0x00, 0x00, 0x00, 0x00, 0x00, 0x00, 0x00, 0x00, 0x00, 0x00,
    0x00, 0x00, 0x00, 0x00, 0x00, 0x00, 0x00, 0x00, 0x00, 0x00, 0x00, 0x00, 0x00, 0x00, 0x00, 0x00,
    0x00, 0x00, 0x00, 0x00, 0x00, 0x00, 0x00, 0x00, 0x00, 0x00, 0x00, 0x00, 0x00, 0x00, 0x00, 0x00,
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    0x00, 0x00, 0x00, 0x00, 0x00, 0x00, 0x00, 0x00, 0x00, 0x00, 0x00, 0x00, 0x00, 0x00, 0x00, 0x00};

const unsigned char WiFiOn[] PROGMEM = {
    // 'wifi-on', 32x32px
    0x00, 0x00, 0x00, 0x00, 0x00, 0x00, 0x00, 0x00, 0x00, 0x00, 0x00, 0x00, 0x00, 0x00, 0x00, 0x00,
    0x00, 0x00, 0x00, 0x00, 0x00, 0x00, 0x00, 0x00, 0x00, 0x00, 0x00, 0x00, 0x00, 0x00, 0x00, 0x00,
    0x00, 0x00, 0x00, 0x00, 0x00, 0x07, 0xe0, 0x00, 0x00, 0x18, 0x18, 0x00, 0x00, 0x20, 0x04, 0x00,
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    0x00, 0x00, 0x00, 0x00, 0x00, 0x00, 0x00, 0x00, 0x00, 0x00, 0x00, 0x00, 0x00, 0x00, 0x00, 0x00};

const unsigned char WiFiOff[] PROGMEM = {
    // 'wifi-off', 32x32px
    0x00, 0x00, 0x00, 0x00, 0x00, 0x00, 0x00, 0x00, 0x00, 0x00, 0x00, 0x00, 0x00, 0x00, 0x00, 0x00,
    0x00, 0x00, 0x00, 0x00, 0x00, 0x00, 0x00, 0x00, 0x00, 0x00, 0x00, 0x00, 0x00, 0x00, 0x00, 0x00,
    0x00, 0x20, 0x00, 0x00, 0x00, 0x13, 0xe0, 0x00, 0x00, 0x08, 0x18, 0x00, 0x00, 0x24, 0x04, 0x00,
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    0x00, 0x00, 0x00, 0x00, 0x00, 0x00, 0x00, 0x00, 0x00, 0x00, 0x00, 0x00, 0x00, 0x00, 0x00, 0x00};


// OLED display TWI address
#define OLED_ADDR 0x3C
// reset pin not used on 4-pin OLED module
Adafruit_SSD1306 display(-1); // -1 = no reset pin

const char *ssid = "Vodafone-71760574";
const char *password = "ufmi3l4mlywzpky";
//const char *ssid = "FASTWEB-B3D943";
//const char *password = "K46FFMH89W";

int relayStatus=0;
byte a=0x00;
byte b=0x00;

IPAddress staticIP(192, 168, 1, 10);
IPAddress gateway(192, 168, 1, 1);  //IP Address of your WiFi Router (Gateway)
IPAddress subnet(255, 255, 255, 0); //Subnet mask
//IPAddress dns(8, 8, 8, 8);  //DNS

// Create an instance of the server
// specify the port to listen on as an argument
WiFiServer server(80);

void setup()
{
  Serial.begin(9600);
  delay(10);
  Wire.begin(2, 0);
  if (!display.begin(SSD1306_SWITCHCAPVCC, OLED_ADDR))
  {
    Serial.println(F("SSD1306 allocation failed"));
    for (;;)
      ; // Don't proceed, loop forever
  }
  display.begin(SSD1306_SWITCHCAPVCC, OLED_ADDR);
  display.setRotation(2);
  display.clearDisplay();
  display.setFont(&Roboto_Mono_Thin_12);
  printBoilerStatus(0);
  printData("00.0-00.0-00.0");
  delay(2000);
  // Connect to WiFi network
  Serial.println();
  Serial.println();
  Serial.print("Connecting to ");
  Serial.println(ssid);
  WiFi.mode(WIFI_STA);
  WiFi.config(staticIP, gateway, subnet);
  startWiFiServer();
}

void loop()
{
  // Check if a client has connected
  if(WiFi.status() == WL_CONNECTION_LOST || WiFi.status() != WL_CONNECTED || WiFi.status() ==WL_DISCONNECTED){
    Serial.println("CONNECTION LOST");
    printData("00.0-00.0-00.0");
    printHand(0);
    setRelayStatus(0);
    delay(1);
    startWiFiServer();
  }

  WiFiClient client = server.available();
  if (!client)
  {
    return;
  }
  Serial.println("new client");
  while (!client.available())
  {
    delay(1);
  }
  checkRequest(client);
}

void startWiFiServer()
{
  WiFi.begin(ssid, password);
  while (WiFi.status() != WL_CONNECTED)
  {
    printWiFiStatus(0);
    delay(500);
    Serial.print(".");
  }
  Serial.println("");
  Serial.println("WiFi connected");
  Serial.print("MAC: ");
  Serial.println(WiFi.macAddress());

  // Start the server
  server.begin();
  Serial.println("Server started");
  printWiFiStatus(1);
  // Print the IP address
  Serial.println(WiFi.localIP());
}

void checkRequest(WiFiClient client)
{
  String req = client.readStringUntil('\r');
  client.flush();
  Serial.println(req);
  //Prepare the response
  String s = "HTTP/1.1 200 OK\r\nAccess-Control-Allow-Origin: *\r\nContent-Type: text/plain\r\n\r\n";
  //GPIO
  if (req.indexOf("/status/") != -1)
  {
    s+=relayStatus;
  }else if (req.indexOf("/gpio/0") != -1)
  {
    s+=0;
    setRelayStatus(0);
  }
  else if (req.indexOf("/gpio/1") != -1)
  {
    s+=1;
    setRelayStatus(1);
  }
  else if (req.indexOf("/hand/0") != -1)
  {
    printHand(0);
    s += 0;
  }
  else if (req.indexOf("/hand/1") != -1)
  {
    printHand(1);
    s += 1;
  }
  else if (req.indexOf("/data/") != -1)
  {
    String res = "";
    //data format: /data/22.5-18.0-45
    res = req.substring(0, req.lastIndexOf(' '));
    res = res.substring(res.lastIndexOf("/") + 1);
    s += "res " + res;
    printData(res);
  }
  else
  {
    Serial.println("invalid request");
    s += 'ERROR invalid request';
//    delay(100);
//    return;
  }
// Send the response to the client
  client.flush();
  client.print(s);
  delay(300);
  //Serial.println("Client disonnected");
}

int setRelayStatus(int val){
  if(val==relayStatus) return val;
  Serial.println("Set Boiler status to ");
  Serial.print(val);
  Serial.println();
  relayStatus = val;
  //relay:OFF A00100A1
  //relay:ON A00101A2
  a = val==0?0x00:0x01;
  b = val==0?0xA1:0xA2;

  Serial.print("Serial command: A001-");
  Serial.print(a,HEX);
  Serial.print(b,HEX);
  Serial.println();
  delay(1);
  byte message[] = {0xA0, 0x01, a, b};
  Serial.write(message, sizeof(message));
  Serial.write('\n');
  printBoilerStatus(relayStatus);
  return val;
}

String printData(String data)
{
  String temp = data.substring(0, data.indexOf("-"));
  String settemp = data.substring(data.indexOf("-") + 1, data.lastIndexOf("-"));
  String humi = data.substring(data.lastIndexOf("-") + 1);
  display.fillRect(83, 0, 45, 64, 0);
  display.setTextColor(WHITE);
  display.setCursor(83, 12);
  display.println(temp);
  display.drawCircle(124, 3, 2, 1);
  display.setCursor(83, 32);
  display.println(settemp);
  display.drawCircle(124, 23, 2, 1);
  display.setCursor(83, 52);
  display.println(humi);
  display.setCursor(118, 52);
  display.println("%");
  display.display();
  return data;
}

int printWiFiStatus(int status)
{
  //0 offline 1 connected
  display.fillRect(0, 0, 32, 32, 0);
  display.display();
  delay(100);
  display.drawBitmap(0, 0, (status == 0 ? WiFiOff : WiFiOn), 32, 32, 1);
  display.display();
  return status;
}

int printBoilerStatus(int status)
{
  //0 off 1 on
  display.fillRect(30, 0, 42, 64, 0);
  display.drawBitmap(30, 0, (status == 0 ? BoilerOff : BoilerOn), 42, 64, 1);
  display.display();
  return status;
}

int printHand(int val)
{
  display.fillRect(0, 32, 32, 32, 0);
  if (val == 1)
    display.drawBitmap(0, 32, Hand, 32, 32, 1);
  display.display();
  return val;
}
